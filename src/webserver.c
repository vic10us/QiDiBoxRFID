#include "webserver.h"
#include "config.h"
#include "pn532.h"
#include "led.h"
#include "wifi.h"
#include <string.h>
#include <stdlib.h>
#include "esp_log.h"
#include "esp_timer.h"
#include "esp_system.h"
#include "nvs.h"
#include "nvs_flash.h"
#include "driver/gpio.h"
#include "freertos/FreeRTOS.h"
#include "freertos/task.h"

static const char *TAG = "web";

// Embedded web files (gzipped, generated by scripts/gen_web_assets.py at build time)
#include "web_assets.h"

static esp_err_t send_gzipped(httpd_req_t *req, const char *content_type,
                               const char *data, size_t len)
{
    httpd_resp_set_type(req, content_type);
    httpd_resp_set_hdr(req, "Content-Encoding", "gzip");
    return httpd_resp_send(req, data, len);
}

// Shared NFC state — defined in main.c
extern pn532_t nfc_dev;
extern bool nfc_busy;

typedef enum {
    CARD_UNKNOWN = 0,
    CARD_MIFARE_CLASSIC,
    CARD_MIFARE_ULTRALIGHT
} card_type_t;

#define MAX_TAG_DATA 256
#define CLASSIC_BLOCKS_TO_READ 16
#define UL_PAGES_TO_READ 44
#define QIDI_BLOCK 4

typedef struct {
    bool valid;
    uint8_t uid[7];
    uint8_t uid_len;
    card_type_t card_type;
    uint8_t data[MAX_TAG_DATA];
    uint16_t data_len;
    uint8_t pages_read;
    uint8_t blocks_read;
    bool is_qidi_format;
    bool auth_failed;
    bool read_failed;
    uint32_t timestamp;
} tag_data_t;

static inline uint32_t millis(void)
{
    return (uint32_t)(esp_timer_get_time() / 1000);
}

// Shared tag state
tag_data_t last_tag = {};
uint8_t prev_uid[7] = {0};
uint8_t prev_uid_len = 0;
bool tag_present = false;

// LED timing
uint32_t led_ok_until = 0;
uint32_t led_err_until = 0;

static uint8_t default_key[6] = {0xFF, 0xFF, 0xFF, 0xFF, 0xFF, 0xFF};

static const char *card_type_name(card_type_t ct)
{
    switch (ct) {
        case CARD_MIFARE_CLASSIC:    return "MIFARE Classic";
        case CARD_MIFARE_ULTRALIGHT: return "MIFARE Ultralight / NTAG";
        default:                     return "Unknown";
    }
}

static card_type_t detect_card_type(uint8_t uid_len)
{
    switch (uid_len) {
        case 4:  return CARD_MIFARE_CLASSIC;
        case 7:  return CARD_MIFARE_ULTRALIGHT;
        default: return CARD_UNKNOWN;
    }
}

// --- Helper to extract URL query param ---
static bool get_query_param(httpd_req_t *req, const char *key, char *val, size_t val_size)
{
    size_t buf_len = httpd_req_get_url_query_len(req) + 1;
    if (buf_len <= 1) return false;

    char *buf = malloc(buf_len);
    if (!buf) return false;

    if (httpd_req_get_url_query_str(req, buf, buf_len) != ESP_OK) {
        free(buf);
        return false;
    }

    esp_err_t err = httpd_query_key_value(buf, key, val, val_size);
    free(buf);
    return err == ESP_OK;
}

// URL-decode in place
static void url_decode(char *s)
{
    char *r = s, *w = s;
    while (*r) {
        if (*r == '+') {
            *w++ = ' ';
            r++;
        } else if (*r == '%' && r[1] && r[2]) {
            char hex[3] = {r[1], r[2], 0};
            *w++ = (char)strtol(hex, NULL, 16);
            r += 3;
        } else {
            *w++ = *r++;
        }
    }
    *w = '\0';
}

// --- Helper to extract POST form field ---
static bool get_post_param(const char *body, const char *key, char *val, size_t val_size)
{
    if (httpd_query_key_value(body, key, val, val_size) != ESP_OK) return false;
    url_decode(val);
    return true;
}

// --- Static file handlers ---

static esp_err_t handle_index(httpd_req_t *req)
{
    return send_gzipped(req, "text/html", index_html, index_html_len);
}

static esp_err_t handle_style(httpd_req_t *req)
{
    return send_gzipped(req, "text/css", style_css, style_css_len);
}

static esp_err_t handle_app_js(httpd_req_t *req)
{
    return send_gzipped(req, "application/javascript", app_js, app_js_len);
}

static esp_err_t handle_setup(httpd_req_t *req)
{
    return send_gzipped(req, "text/html", setup_html, setup_html_len);
}

static esp_err_t handle_settings(httpd_req_t *req)
{
    return send_gzipped(req, "text/html", settings_html, settings_html_len);
}

// --- API handlers ---

static esp_err_t handle_status(httpd_req_t *req)
{
    httpd_resp_set_type(req, "application/json");

    if (!last_tag.valid) {
        return httpd_resp_sendstr(req, "{\"tagPresent\":false,\"timestamp\":0}");
    }

    char uid_str[22];
    int uid_pos = 0;
    for (int i = 0; i < last_tag.uid_len; i++) {
        uid_pos += snprintf(uid_str + uid_pos, sizeof(uid_str) - uid_pos,
                            "%s%02X", i ? ":" : "", last_tag.uid[i]);
    }

    char hex_str[800];
    int hex_pos = 0;
    for (int i = 0; i < last_tag.data_len && hex_pos < (int)sizeof(hex_str) - 4; i++) {
        hex_pos += snprintf(hex_str + hex_pos, sizeof(hex_str) - hex_pos,
                            "%s%02X", i ? " " : "", last_tag.data[i]);
    }
    if (last_tag.data_len == 0) hex_str[0] = '\0';

    uint8_t material = 0, color = 0, manufacturer = 0;
    if (last_tag.card_type == CARD_MIFARE_CLASSIC && last_tag.data_len >= (QIDI_BLOCK + 1) * 16) {
        material     = last_tag.data[QIDI_BLOCK * 16];
        color        = last_tag.data[QIDI_BLOCK * 16 + 1];
        manufacturer = last_tag.data[QIDI_BLOCK * 16 + 2];
    }

    char *json = malloc(1200);
    if (!json) {
        httpd_resp_send_err(req, HTTPD_500_INTERNAL_SERVER_ERROR, "Out of memory");
        return ESP_FAIL;
    }

    snprintf(json, 1200,
        "{\"tagPresent\":true,"
        "\"uid\":\"%s\","
        "\"cardType\":\"%s\","
        "\"cardTypeId\":%d,"
        "\"isQidiFormat\":%s,"
        "\"material\":%d,"
        "\"color\":%d,"
        "\"manufacturer\":%d,"
        "\"dataLen\":%d,"
        "\"blocksRead\":%d,"
        "\"pagesRead\":%d,"
        "\"raw\":\"%s\","
        "\"authFailed\":%s,"
        "\"readFailed\":%s,"
        "\"timestamp\":%lu}",
        uid_str,
        card_type_name(last_tag.card_type),
        (int)last_tag.card_type,
        last_tag.is_qidi_format ? "true" : "false",
        material, color, manufacturer,
        last_tag.data_len,
        last_tag.blocks_read,
        last_tag.pages_read,
        hex_str,
        last_tag.auth_failed ? "true" : "false",
        last_tag.read_failed ? "true" : "false",
        (unsigned long)last_tag.timestamp);

    httpd_resp_sendstr(req, json);
    free(json);
    return ESP_OK;
}

static esp_err_t handle_write(httpd_req_t *req)
{
    char val[16];
    if (!get_query_param(req, "material", val, sizeof(val)) || !val[0]) {
        httpd_resp_send_err(req, HTTPD_400_BAD_REQUEST, "Missing material parameter.");
        return ESP_FAIL;
    }
    uint8_t material = atoi(val);

    if (!get_query_param(req, "color", val, sizeof(val)) || !val[0]) {
        httpd_resp_send_err(req, HTTPD_400_BAD_REQUEST, "Missing color parameter.");
        return ESP_FAIL;
    }
    uint8_t color_code = atoi(val);

    if (material < 1 || material > 50) {
        httpd_resp_send_err(req, HTTPD_400_BAD_REQUEST, "Material code out of range (1-50).");
        return ESP_FAIL;
    }
    if (color_code < 1 || color_code > 24) {
        httpd_resp_send_err(req, HTTPD_400_BAD_REQUEST, "Color code out of range (1-24).");
        return ESP_FAIL;
    }

    ESP_LOGI(TAG, "Write request — Material: %d, Color: %d", material, color_code);

    nfc_busy = true;
    led_busy();

    uint8_t uid[7];
    uint8_t uid_len;
    bool found = false;

    uint32_t deadline = millis() + 10000;
    while (millis() < deadline) {
        if (pn532_read_passive_target(&nfc_dev, uid, &uid_len, 500)) {
            found = true;
            break;
        }
    }

    if (!found) {
        led_err();
        led_err_until = millis() + hw_cfg.duration_err;
        nfc_busy = false;
        httpd_resp_set_status(req, "408 Request Timeout");
        return httpd_resp_sendstr(req, "No tag detected within 10 seconds. Try again.");
    }

    card_type_t ct = detect_card_type(uid_len);
    if (ct != CARD_MIFARE_CLASSIC) {
        led_err();
        led_err_until = millis() + hw_cfg.duration_err;
        nfc_busy = false;
        char msg[128];
        snprintf(msg, sizeof(msg),
            "Wrong card type: %s. Only MIFARE Classic 1K tags are supported for writing.",
            card_type_name(ct));
        httpd_resp_send_err(req, HTTPD_400_BAD_REQUEST, msg);
        return ESP_FAIL;
    }

    if (!pn532_mifare_authenticate(&nfc_dev, uid, uid_len, QIDI_BLOCK, 0, default_key)) {
        led_err();
        led_err_until = millis() + hw_cfg.duration_err;
        nfc_busy = false;
        httpd_resp_send_err(req, HTTPD_500_INTERNAL_SERVER_ERROR,
            "Authentication failed. Tag may use non-default keys.");
        return ESP_FAIL;
    }

    uint8_t data[16] = {0};
    data[0] = material;
    data[1] = color_code;
    data[2] = 0x01;

    if (!pn532_mifare_write_block(&nfc_dev, QIDI_BLOCK, data)) {
        led_err();
        led_err_until = millis() + hw_cfg.duration_err;
        nfc_busy = false;
        httpd_resp_send_err(req, HTTPD_500_INTERNAL_SERVER_ERROR, "Write failed.");
        return ESP_FAIL;
    }

    uint8_t readback[16];
    if (!pn532_mifare_read_block(&nfc_dev, QIDI_BLOCK, readback)) {
        led_err();
        led_err_until = millis() + hw_cfg.duration_err;
        nfc_busy = false;
        httpd_resp_send_err(req, HTTPD_500_INTERNAL_SERVER_ERROR,
            "Write succeeded but verification read failed.");
        return ESP_FAIL;
    }

    if (readback[0] != material || readback[1] != color_code || readback[2] != 0x01) {
        led_err();
        led_err_until = millis() + hw_cfg.duration_err;
        nfc_busy = false;
        httpd_resp_send_err(req, HTTPD_500_INTERNAL_SERVER_ERROR,
            "Verification failed — data mismatch after write.");
        return ESP_FAIL;
    }

    // Update tag state
    memset(&last_tag, 0, sizeof(last_tag));
    last_tag.valid = true;
    memcpy(last_tag.uid, uid, uid_len);
    last_tag.uid_len = uid_len;
    last_tag.card_type = CARD_MIFARE_CLASSIC;
    memcpy(last_tag.data + (QIDI_BLOCK * 16), readback, 16);
    last_tag.data_len = CLASSIC_BLOCKS_TO_READ * 16;
    last_tag.blocks_read = 1;
    last_tag.is_qidi_format = true;
    last_tag.timestamp = millis();

    tag_present = true;
    prev_uid_len = uid_len;
    memcpy(prev_uid, uid, uid_len);

    led_ok();
    led_ok_until = millis() + hw_cfg.duration_ok;
    nfc_busy = false;

    char msg[96];
    snprintf(msg, sizeof(msg),
        "Tag written and verified! Material: 0x%02X  Color: 0x%02X  Mfr: 0x01",
        material, color_code);
    ESP_LOGI(TAG, "%s", msg);
    return httpd_resp_sendstr(req, msg);
}

static esp_err_t handle_clear(httpd_req_t *req)
{
    ESP_LOGI(TAG, "Clear request received");

    nfc_busy = true;
    led_busy();

    uint8_t uid[7];
    uint8_t uid_len;
    bool found = false;

    uint32_t deadline = millis() + 10000;
    while (millis() < deadline) {
        if (pn532_read_passive_target(&nfc_dev, uid, &uid_len, 500)) {
            found = true;
            break;
        }
    }

    if (!found) {
        led_err();
        led_err_until = millis() + hw_cfg.duration_err;
        nfc_busy = false;
        httpd_resp_set_status(req, "408 Request Timeout");
        return httpd_resp_sendstr(req, "No tag detected within 10 seconds.");
    }

    card_type_t ct = detect_card_type(uid_len);
    uint8_t zeros[16] = {0};

    if (ct == CARD_MIFARE_CLASSIC) {
        if (!pn532_mifare_authenticate(&nfc_dev, uid, uid_len, QIDI_BLOCK, 0, default_key)) {
            led_err();
            led_err_until = millis() + hw_cfg.duration_err;
            nfc_busy = false;
            httpd_resp_send_err(req, HTTPD_500_INTERNAL_SERVER_ERROR, "Authentication failed.");
            return ESP_FAIL;
        }
        bool ok = true;
        for (uint8_t b = 4; b <= 6; b++) {
            if (!pn532_mifare_write_block(&nfc_dev, b, zeros)) {
                ok = false;
                break;
            }
        }
        if (!ok) {
            led_err();
            led_err_until = millis() + hw_cfg.duration_err;
            nfc_busy = false;
            httpd_resp_send_err(req, HTTPD_500_INTERNAL_SERVER_ERROR,
                "Clear failed — could not write to block.");
            return ESP_FAIL;
        }
        memset(&last_tag, 0, sizeof(last_tag));
        last_tag.valid = true;
        memcpy(last_tag.uid, uid, uid_len);
        last_tag.uid_len = uid_len;
        last_tag.card_type = ct;
        last_tag.data_len = CLASSIC_BLOCKS_TO_READ * 16;
        last_tag.blocks_read = 3;
        last_tag.timestamp = millis();

    } else if (ct == CARD_MIFARE_ULTRALIGHT) {
        uint8_t zero_page[4] = {0};
        uint8_t cleared = 0;
        for (uint8_t page = 4; page < UL_PAGES_TO_READ; page++) {
            if (!pn532_ultralight_write_page(&nfc_dev, page, zero_page)) break;
            cleared++;
        }
        if (cleared == 0) {
            led_err();
            led_err_until = millis() + hw_cfg.duration_err;
            nfc_busy = false;
            httpd_resp_send_err(req, HTTPD_500_INTERNAL_SERVER_ERROR,
                "Clear failed — could not write to any page.");
            return ESP_FAIL;
        }
        memset(&last_tag, 0, sizeof(last_tag));
        last_tag.valid = true;
        memcpy(last_tag.uid, uid, uid_len);
        last_tag.uid_len = uid_len;
        last_tag.card_type = ct;
        last_tag.pages_read = cleared + 4;
        last_tag.data_len = last_tag.pages_read * 4;
        last_tag.timestamp = millis();

        ESP_LOGI(TAG, "Cleared %d UL/NTAG pages", cleared);
    } else {
        nfc_busy = false;
        httpd_resp_send_err(req, HTTPD_400_BAD_REQUEST, "Unsupported card type for clearing.");
        return ESP_FAIL;
    }

    tag_present = true;
    prev_uid_len = uid_len;
    memcpy(prev_uid, uid, uid_len);

    led_ok();
    led_ok_until = millis() + hw_cfg.duration_ok;
    nfc_busy = false;
    return httpd_resp_sendstr(req, "Tag cleared successfully.");
}

static esp_err_t handle_wifi_save(httpd_req_t *req)
{
    char body[256];
    int len = httpd_req_recv(req, body, sizeof(body) - 1);
    if (len <= 0) {
        httpd_resp_send_err(req, HTTPD_400_BAD_REQUEST, "No data.");
        return ESP_FAIL;
    }
    body[len] = '\0';

    char ssid[33] = {0};
    char pass[65] = {0};
    if (!get_post_param(body, "ssid", ssid, sizeof(ssid)) || ssid[0] == '\0') {
        httpd_resp_send_err(req, HTTPD_400_BAD_REQUEST, "SSID is required.");
        return ESP_FAIL;
    }
    get_post_param(body, "pass", pass, sizeof(pass)); // optional

    if (strlen(ssid) > 32) {
        httpd_resp_send_err(req, HTTPD_400_BAD_REQUEST, "SSID must be 1-32 characters.");
        return ESP_FAIL;
    }

    nvs_handle_t h;
    if (nvs_open("qidibox", NVS_READWRITE, &h) == ESP_OK) {
        nvs_set_str(h, "ssid", ssid);
        nvs_set_str(h, "pass", pass);
        nvs_commit(h);
        nvs_close(h);
    }

    ESP_LOGI(TAG, "WiFi credentials saved: %s", ssid);
    httpd_resp_sendstr(req, "WiFi credentials saved! The device will restart in 3 seconds...");

    vTaskDelay(pdMS_TO_TICKS(3000));
    esp_restart();
    return ESP_OK; // unreachable
}

// --- Settings API ---

static esp_err_t handle_api_config_get(httpd_req_t *req)
{
    char buf[512];
    config_to_json(&hw_cfg, buf, sizeof(buf));
    httpd_resp_set_type(req, "application/json");
    return httpd_resp_sendstr(req, buf);
}

static esp_err_t handle_api_config_post(httpd_req_t *req)
{
    char body[512];
    int len = httpd_req_recv(req, body, sizeof(body) - 1);
    if (len <= 0) {
        httpd_resp_send_err(req, HTTPD_400_BAD_REQUEST, "No data.");
        return ESP_FAIL;
    }
    body[len] = '\0';

    char val[32];
    bool restart_required = false;

    if (get_post_param(body, "led_en", val, sizeof(val)))
        hw_cfg.led_enabled = atoi(val) != 0;
    if (get_post_param(body, "led_type", val, sizeof(val))) {
        uint8_t t = atoi(val);
        if (t <= 2) hw_cfg.led_type = (led_type_t)t;
    }
    if (get_post_param(body, "led_pin", val, sizeof(val)))
        hw_cfg.led_pin = atoi(val);
    if (get_post_param(body, "led_bright", val, sizeof(val)))
        hw_cfg.led_brightness = atoi(val);
    if (get_post_param(body, "led_len", val, sizeof(val))) {
        uint8_t new_len = atoi(val);
        if (new_len < 1) new_len = 1;
        if (new_len != hw_cfg.led_length) { hw_cfg.led_length = new_len; restart_required = true; }
    }
    if (get_post_param(body, "led_skip", val, sizeof(val))) {
        uint8_t new_skip = atoi(val);
        if (new_skip >= hw_cfg.led_length) new_skip = 0;
        if (new_skip != hw_cfg.led_skip) { hw_cfg.led_skip = new_skip; restart_required = true; }
    }

    if (get_post_param(body, "c_scan", val, sizeof(val)))
        hw_cfg.color_scan = hex_to_color(val);
    if (get_post_param(body, "c_ok", val, sizeof(val)))
        hw_cfg.color_ok = hex_to_color(val);
    if (get_post_param(body, "c_err", val, sizeof(val)))
        hw_cfg.color_err = hex_to_color(val);
    if (get_post_param(body, "c_busy", val, sizeof(val)))
        hw_cfg.color_busy = hex_to_color(val);
    if (get_post_param(body, "c_setup", val, sizeof(val)))
        hw_cfg.color_setup = hex_to_color(val);

    if (get_post_param(body, "t_ok", val, sizeof(val)))
        hw_cfg.duration_ok = atoi(val);
    if (get_post_param(body, "t_err", val, sizeof(val)))
        hw_cfg.duration_err = atoi(val);

    if (get_post_param(body, "i2c_sda", val, sizeof(val))) {
        uint8_t new_sda = atoi(val);
        if (new_sda != hw_cfg.sda_pin) { hw_cfg.sda_pin = new_sda; restart_required = true; }
    }
    if (get_post_param(body, "i2c_scl", val, sizeof(val))) {
        uint8_t new_scl = atoi(val);
        if (new_scl != hw_cfg.scl_pin) { hw_cfg.scl_pin = new_scl; restart_required = true; }
    }
    if (get_post_param(body, "boot_pin", val, sizeof(val)))
        hw_cfg.boot_pin = atoi(val);

    config_save(&hw_cfg);

    if (hw_cfg.led_type == LED_GPIO) {
        gpio_config_t io_conf = {
            .pin_bit_mask = (1ULL << hw_cfg.led_pin),
            .mode = GPIO_MODE_OUTPUT,
        };
        gpio_config(&io_conf);
    }

    char resp[64];
    snprintf(resp, sizeof(resp), "{\"ok\":true,\"restart_required\":%s}",
        restart_required ? "true" : "false");
    httpd_resp_set_type(req, "application/json");
    return httpd_resp_sendstr(req, resp);
}

static esp_err_t handle_api_config_reset(httpd_req_t *req)
{
    config_reset();
    config_load(&hw_cfg);
    httpd_resp_set_type(req, "application/json");
    return httpd_resp_sendstr(req,
        "{\"ok\":true,\"message\":\"Reset to defaults. Restart recommended.\"}");
}

static esp_err_t handle_api_restart(httpd_req_t *req)
{
    httpd_resp_set_type(req, "application/json");
    httpd_resp_sendstr(req, "{\"ok\":true}");
    vTaskDelay(pdMS_TO_TICKS(500));
    esp_restart();
    return ESP_OK;
}

// Captive portal: redirect unknown paths to root
static esp_err_t handle_captive_redirect(httpd_req_t *req)
{
    char ip[16];
    wifi_get_ip_str(ip, sizeof(ip));
    char location[48];
    snprintf(location, sizeof(location), "http://%s/", ip);
    httpd_resp_set_status(req, "302 Found");
    httpd_resp_set_hdr(req, "Location", location);
    return httpd_resp_send(req, NULL, 0);
}

// Route for /api/config that dispatches GET vs POST
static esp_err_t handle_api_config(httpd_req_t *req)
{
    // httpd registers by method, so this is only for GET
    return handle_api_config_get(req);
}

httpd_handle_t webserver_start(bool ap_mode)
{
    httpd_config_t config = HTTPD_DEFAULT_CONFIG();
    config.max_uri_handlers = 20;
    config.uri_match_fn = httpd_uri_match_wildcard;
    config.stack_size = 8192;

    httpd_handle_t server = NULL;
    if (httpd_start(&server, &config) != ESP_OK) {
        ESP_LOGE(TAG, "Failed to start web server");
        return NULL;
    }

    // Settings routes (available in both modes)
    httpd_uri_t settings_page = { .uri = "/settings", .method = HTTP_GET, .handler = handle_settings };
    httpd_uri_t api_config_get = { .uri = "/api/config", .method = HTTP_GET, .handler = handle_api_config };
    httpd_uri_t api_config_post = { .uri = "/api/config", .method = HTTP_POST, .handler = handle_api_config_post };
    httpd_uri_t api_config_reset = { .uri = "/api/config/reset", .method = HTTP_POST, .handler = handle_api_config_reset };
    httpd_uri_t api_restart = { .uri = "/api/restart", .method = HTTP_POST, .handler = handle_api_restart };
    httpd_uri_t wifi_save = { .uri = "/wifi-save", .method = HTTP_POST, .handler = handle_wifi_save };

    httpd_register_uri_handler(server, &settings_page);
    httpd_register_uri_handler(server, &api_config_get);
    httpd_register_uri_handler(server, &api_config_post);
    httpd_register_uri_handler(server, &api_config_reset);
    httpd_register_uri_handler(server, &api_restart);
    httpd_register_uri_handler(server, &wifi_save);

    if (ap_mode) {
        httpd_uri_t root = { .uri = "/", .method = HTTP_GET, .handler = handle_setup };
        httpd_register_uri_handler(server, &root);

        // Wildcard catch-all for captive portal
        httpd_uri_t catchall = { .uri = "/*", .method = HTTP_GET, .handler = handle_captive_redirect };
        httpd_register_uri_handler(server, &catchall);
    } else {
        httpd_uri_t root = { .uri = "/", .method = HTTP_GET, .handler = handle_index };
        httpd_uri_t style = { .uri = "/style.css", .method = HTTP_GET, .handler = handle_style };
        httpd_uri_t js = { .uri = "/app.js", .method = HTTP_GET, .handler = handle_app_js };
        httpd_uri_t wifi_setup = { .uri = "/wifi-setup", .method = HTTP_GET, .handler = handle_setup };
        httpd_uri_t status = { .uri = "/status", .method = HTTP_GET, .handler = handle_status };
        httpd_uri_t write = { .uri = "/write", .method = HTTP_GET, .handler = handle_write };
        httpd_uri_t clear = { .uri = "/clear", .method = HTTP_GET, .handler = handle_clear };

        httpd_register_uri_handler(server, &root);
        httpd_register_uri_handler(server, &style);
        httpd_register_uri_handler(server, &js);
        httpd_register_uri_handler(server, &wifi_setup);
        httpd_register_uri_handler(server, &status);
        httpd_register_uri_handler(server, &write);
        httpd_register_uri_handler(server, &clear);
    }

    ESP_LOGI(TAG, "Web server started (%s mode)", ap_mode ? "AP" : "STA");
    return server;
}

void webserver_stop(httpd_handle_t server)
{
    if (server) httpd_stop(server);
}
