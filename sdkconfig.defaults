## sdkconfig.defaults
```kconfig
CONFIG_FREERTOS_HZ=1000

# Flash + OTA partition layout (overridden per-env via platformio.ini for 4MB boards)
CONFIG_ESPTOOLPY_FLASHSIZE_8MB=y
CONFIG_ESPTOOLPY_FLASHSIZE="8MB"
CONFIG_PARTITION_TABLE_CUSTOM=y
CONFIG_PARTITION_TABLE_CUSTOM_FILENAME="partitions.csv"

# Console: USB-Serial-JTAG for all boards (works on S3, C3, C6 dev kits and XIAO C6).
# UART0 is left free for application use.
# CONFIG_ESP_CONSOLE_UART_DEFAULT is not set
# CONFIG_ESP_CONSOLE_NONE is not set
# CONFIG_ESP_CONSOLE_UART_CUSTOM is not set
CONFIG_ESP_CONSOLE_USB_SERIAL_JTAG=y
# CONFIG_ESP_CONSOLE_SECONDARY_USB_SERIAL_JTAG is not set
CONFIG_ESP_CONSOLE_SECONDARY_NONE=y

# Size optimizations
CONFIG_COMPILER_OPTIMIZATION_SIZE=y
CONFIG_NEWLIB_NANO_FORMAT=y
CONFIG_MBEDTLS_CERTIFICATE_BUNDLE=n
CONFIG_LOG_DEFAULT_LEVEL_INFO=y
```

## sdkconfig.defaults.seeed_xiao_esp32c6
```kconfig
# Overrides for Seeed XIAO ESP32-C6 (4MB flash)
CONFIG_ESPTOOLPY_FLASHSIZE_8MB=n
CONFIG_ESPTOOLPY_FLASHSIZE_4MB=y
CONFIG_ESPTOOLPY_FLASHSIZE="4MB"
CONFIG_PARTITION_TABLE_CUSTOM_FILENAME="partitions_4mb.csv"
```
